## boards/arm/M71nrf/Kconfig.board
```kconfig
# Copyright (c) 2021 Nick Winans
# SPDX-License-Identifier: MIT

config BOARD_M71NRF
    bool "M71nrf"
    depends on SOC_NRF52840_QIAA
```

## boards/arm/M71nrf/Kconfig.defconfig
```kconfig
# Copyright (c) 2021 Nick Winans
# SPDX-License-Identifier: MIT

if BOARD_M71NRF

config ZMK_KEYBOARD_NAME
    default "M71nrf"

if USB_DEVICE_STACK

config USB_NRFX
    default y

endif # USB_DEVICE_STACK

config BT_CTLR
    default BT

endif # BOARD_M71NRF
```
